// SPDX-License-Identifier: (GPL-2.0+ OR MIT)
/*
 * Copyright (c) 2021 Rockchip Electronics Co., Ltd.
 * Copyright (c) 2023 EmbedFire <embedfire@embedfire.com>
 */

/dts-v1/;

#include <dt-bindings/usb/pd.h>
#include <dt-bindings/gpio/gpio.h>
#include <dt-bindings/pwm/pwm.h>
#include <dt-bindings/pinctrl/rockchip.h>
//#include <dt-bindings/input/rk-input.h>
#include <dt-bindings/input/linux-event-codes.h>
#include <dt-bindings/display/drm_mipi_dsi.h>
#include <dt-bindings/display/rockchip_vop.h>
#include <dt-bindings/sensor-dev.h>
#include "rk3588.dtsi"
#include "rk3588-android.dtsi"

/ {
	model = "Embedfire LubanCat-5IO UDM";
	compatible = "embedfire,rk3588-lubancat-5io-udm", "rockchip,rk3588";

	/* If hdmirx node is disabled, delete the reserved-memory node here. */
	reserved-memory {
		#address-cells = <2>;
		#size-cells = <2>;
		ranges;
		/* Reserve 256MB memory for hdmirx-controller@fdee0000 */
		cma {
			compatible = "shared-dma-pool";
			reusable;
			reg = <0x0 (256 * 0x100000) 0x0 (256 * 0x100000)>;
			linux,cma-default;
		};
	};

	leds: leds {
		status = "okay";
		compatible = "gpio-leds";

		sys_led: sys-led {
			label = "sys_led";
			linux,default-trigger = "heartbeat";
			default-state = "on";
			gpios = <&gpio1 RK_PC6 GPIO_ACTIVE_HIGH>;
			pinctrl-names = "default";
			pinctrl-0 = <&sys_led_pin>;
		};
	};

	vcc12v_dcin: vcc12v-dcin {
		compatible = "regulator-fixed";
		regulator-always-on;
		regulator-boot-on;
		regulator-min-microvolt = <12000000>;
		regulator-max-microvolt = <12000000>;
		regulator-name = "vcc12v_dcin";
	};

	vcc4v0_sys: vcc4v0-sys {
		compatible = "regulator-fixed";
		regulator-name = "vcc4v0_sys";
		regulator-always-on;
		regulator-boot-on;
		regulator-min-microvolt = <4000000>;
		regulator-max-microvolt = <4000000>;
		vin-supply = <&vcc12v_dcin>;
	};

	vcc_5v0_s0: vcc-5v0-s0 {
		compatible = "regulator-fixed";
		regulator-name = "vcc_5v0_s0";
		regulator-always-on;
		regulator-boot-on;
		regulator-min-microvolt = <5000000>;
		regulator-max-microvolt = <5000000>;
		vin-supply = <&vcc12v_dcin>;
	};

	vcc5v0_usb_s0: vcc5v0-usb-s0 {
		compatible = "regulator-fixed";
		regulator-name = "vcc5v0_usb_s0";
		regulator-always-on;
		regulator-boot-on;
		regulator-min-microvolt = <5000000>;
		regulator-max-microvolt = <5000000>;
		vin-supply = <&vcc12v_dcin>;
	};

	combophy_avdd0v85: combophy-avdd0v85 {
		compatible = "regulator-fixed";
		regulator-name = "combophy_avdd0v85";
		regulator-boot-on;
		regulator-min-microvolt = <850000>;
		regulator-max-microvolt = <850000>;
		vin-supply = <&avdd_0v85_s0>;
	};

	combophy_avdd1v8: combophy-avdd1v8 {
		compatible = "regulator-fixed";
		regulator-name = "combophy_avdd1v8";
		regulator-boot-on;
		regulator-min-microvolt = <1800000>;
		regulator-max-microvolt = <1800000>;
		vin-supply = <&avcc_1v8_s0>;
	};

	vcc_1v1_nldo_s3: vcc-1v1-nldo-s3 {
		compatible = "regulator-fixed";
		regulator-name = "vcc_1v1_nldo_s3";
		regulator-always-on;
		regulator-boot-on;
		regulator-min-microvolt = <1100000>;
		regulator-max-microvolt = <1100000>;
		vin-supply = <&vcc4v0_sys>;
	};

	vcc_3v3_s0: vcc-3v3-s0 {
		compatible = "regulator-fixed";
		regulator-name = "vcc_3v3_s0";
		regulator-always-on;
		regulator-boot-on;
		regulator-min-microvolt = <3300000>;
		regulator-max-microvolt = <3300000>;
		vin-supply = <&vcc_3v3_s3>;
	};

	vcc3v3_sd_s3: vcc3v3-sd-s3 {
		compatible = "regulator-fixed";
		regulator-name = "vcc3v3_sd_s3";
		regulator-always-on;
		regulator-boot-on;
		regulator-min-microvolt = <3300000>;
		regulator-max-microvolt = <3300000>;
		vin-supply = <&vcc_3v3_s3>;
	};

	vbus5v0_typec: vbus5v0-typec {
		compatible = "regulator-fixed";
		regulator-name = "vbus5v0_typec";
		regulator-min-microvolt = <5000000>;
		regulator-max-microvolt = <5000000>;
		regulator-always-on;
		enable-active-high;
		regulator-boot-on;
		gpio = <&gpio4 RK_PA3 GPIO_ACTIVE_HIGH>;
		vin-supply = <&vcc5v0_usb_s0>;
		pinctrl-names = "default";
		pinctrl-0 = <&typec_vbus_en>;
	};

	vcc5v0_usb30_otg: vcc5v0-usb30-otg {
		compatible = "regulator-fixed";
		regulator-name = "vcc5v0_usb30_otg";
		regulator-min-microvolt = <5000000>;
		regulator-max-microvolt = <5000000>;
		regulator-always-on;
		enable-active-high;
		regulator-boot-on;
		gpio = <&gpio4 RK_PA4 GPIO_ACTIVE_HIGH>;
		vin-supply = <&vcc5v0_usb_s0>;
		pinctrl-names = "default";
		pinctrl-0 = <&vcc5v0_usb30_otg_en>;
	};

	vcc5v0_usb20_hub: vcc5v0-usb20-hub {
		compatible = "regulator-fixed";
		regulator-name = "vcc5v0_usb20_hub";
		regulator-min-microvolt = <5000000>;
		regulator-max-microvolt = <5000000>;
		regulator-always-on;
		enable-active-high;
		regulator-boot-on;
		gpio = <&gpio4 RK_PA5 GPIO_ACTIVE_HIGH>;
		vin-supply = <&vcc5v0_usb_s0>;
		pinctrl-names = "default";
		pinctrl-0 = <&vcc5v0_usb20_hub_en>;
	};

	vcc5v0_usb20_host: vcc5v0-usb20-host {
		compatible = "regulator-fixed";
		regulator-name = "vcc5v0_usb20_host";
		regulator-min-microvolt = <5000000>;
		regulator-max-microvolt = <5000000>;
		regulator-always-on;
		enable-active-high;
		regulator-boot-on;
		gpio = <&gpio2 RK_PC3 GPIO_ACTIVE_HIGH>;
		vin-supply = <&vcc5v0_usb_s0>;
		pinctrl-names = "default";
		pinctrl-0 = <&vcc5v0_usb20_host_en>;
	};

	vcc3v3_m2_pcie: vcc3v3-m2-pcie {
		compatible = "regulator-fixed";
		regulator-name = "vcc3v3_m2_pcie";
		regulator-min-microvolt = <3300000>;
		regulator-max-microvolt = <3300000>;
		regulator-always-on;
		enable-active-high;
		regulator-boot-on;
		gpio = <&gpio2 RK_PC5 GPIO_ACTIVE_HIGH>;
		vin-supply = <&vcc12v_dcin>;
		pinctrl-names = "default";
		pinctrl-0 = <&vcc3v3_m2_pcie_en>;
	};

	vcc3v3_pciex4: vcc3v3-pciex4 {
		compatible = "regulator-fixed";
		regulator-name = "vcc3v3_pciex4";
		regulator-min-microvolt = <3300000>;
		regulator-max-microvolt = <3300000>;
		regulator-always-on;
		enable-active-high;
		regulator-boot-on;
		gpio = <&gpio4 RK_PC6 GPIO_ACTIVE_HIGH>;
		vin-supply = <&vcc12v_dcin>;
		pinctrl-names = "default";
		pinctrl-0 = <&vcc3v3_pcie_en>;
	};

	vcc3v3_mini_pcie: vcc3v3-mini-pcie {
		compatible = "regulator-fixed";
		regulator-name = "vcc3v3_mini_pcie";
		regulator-min-microvolt = <3300000>;
		regulator-max-microvolt = <3300000>;
		regulator-always-on;
		enable-active-high;
		regulator-boot-on;
		gpio = <&gpio1 RK_PD5 GPIO_ACTIVE_HIGH>;
		vin-supply = <&vcc12v_dcin>;
		pinctrl-names = "default";
		pinctrl-0 = <&vcc3v3_mini_pcie_en>;
	};

	vcc3v3_ekey_pcie: vcc3v3-ekey-pcie {
		compatible = "regulator-fixed";
		regulator-name = "vcc3v3_ekey_pcie";
		regulator-min-microvolt = <3300000>;
		regulator-max-microvolt = <3300000>;
		regulator-always-on;
		enable-active-high;
		regulator-boot-on;
		gpio = <&gpio0 RK_PB7 GPIO_ACTIVE_HIGH>;
		vin-supply = <&vcc12v_dcin>;
		pinctrl-names = "default";
		pinctrl-0 = <&vcc3v3_ekey_pcie_en>;
	};

	sata_power: sata-power {
		compatible = "regulator-fixed";
		regulator-name = "sata_power";
		regulator-always-on;
		enable-active-high;
		regulator-boot-on;
		gpio = <&gpio1 RK_PD3 GPIO_ACTIVE_HIGH>;
		vin-supply = <&vcc12v_dcin>;
		pinctrl-names = "default";
		pinctrl-0 = <&sata_power_en>;
	};

	mipi_dsi0_power: mipi-dsi0-power-regulator {
		compatible = "regulator-fixed";
		regulator-name = "mipi_dsi0_power";
		regulator-always-on;
		enable-active-high;
		regulator-boot-on;
		gpio = <&gpio1 RK_PC0 GPIO_ACTIVE_HIGH>;
		vin-supply = <&vcc_5v0_s0>;
		pinctrl-names = "default";
		pinctrl-0 = <&mipi_dsi0_power_en>;
	};

	mipi_dsi1_power: mipi-dsi1-power-regulator {
		compatible = "regulator-fixed";
		regulator-name = "mipi_dsi1_power";
		regulator-always-on;
		enable-active-high;
		regulator-boot-on;
		gpio = <&gpio1 RK_PC1 GPIO_ACTIVE_HIGH>;
		vin-supply = <&vcc_5v0_s0>;
		pinctrl-names = "default";
		pinctrl-0 = <&mipi_dsi1_power_en>;
	};

	host_wake_wlan: host-wake-wlan {
		compatible = "regulator-fixed";
		regulator-name = "host_wake_wlan";
		regulator-always-on;
		enable-active-high;
		regulator-boot-on;
		gpio = <&gpio0 RK_PC7 GPIO_ACTIVE_HIGH>;
		vin-supply = <&vcc_5v0_s0>;
		pinctrl-names = "default";
		pinctrl-0 = <&host_wake_wlan_pin>;
	};

	host_wake_bt: host-wake-bt {
		compatible = "regulator-fixed";
		regulator-name = "host_wake_bt";
		regulator-always-on;
		enable-active-high;
		regulator-boot-on;
		gpio = <&gpio0 RK_PC6 GPIO_ACTIVE_HIGH>;
		vin-supply = <&vcc_5v0_s0>;
		pinctrl-names = "default";
		pinctrl-0 = <&host_wake_bt_pin>;
	};

	ext_cam0_37m_clk: external-camera-37m-clock {
		compatible = "fixed-clock";
		clock-frequency = <37125000>;
		clock-output-names = "ext_cam0_37m_clk";
		#clock-cells = <0>;
	};

	ext_cam0_25m_clk: external-camera-25m-clock {
		compatible = "fixed-clock";
		clock-frequency = <25000000>;
		clock-output-names = "ext_cam0_25m_clk";
		#clock-cells = <0>;
	};

	ext_cam0_24m_clk: external-camera-24m-clock {
		compatible = "fixed-clock";
		#clock-cells = <0>;
		clock-frequency = <24000000>;
		clock-output-names = "ext_cam0_24m_clk";
	};

	ext_cam0_27m_clk: external-camera-27m-clock {
		compatible = "fixed-clock";
		#clock-cells = <0>;
		clock-frequency = <27000000>;
		clock-output-names = "ext_cam0_27m_clk";
	};

	vdd_cam0_5v: vdd-cam0-5v-regulator {
		compatible = "regulator-fixed";
		regulator-name = "vdd_cam0_5v";
		regulator-always-on;
		regulator-boot-on;
		regulator-min-microvolt = <3300000>;
		regulator-max-microvolt = <3300000>;
	};

	cam0_dovdd: cam0-dovdd {
		compatible = "regulator-fixed";
		regulator-name = "cam0_dovdd";
		regulator-always-on;
		regulator-boot-on;
		regulator-min-microvolt = <1800000>;
		regulator-max-microvolt = <1800000>;
		vin-supply = <&vdd_cam0_5v>;
	};

	cam0_avdd: cam0-avdd {
		compatible = "regulator-fixed";
		regulator-name = "cam0_avdd";
		regulator-always-on;
		regulator-boot-on;
		regulator-min-microvolt = <2800000>;
		regulator-max-microvolt = <2800000>;
		vin-supply = <&vdd_cam0_5v>;
	};

	cam0_dvdd: cam0-dvdd {
		compatible = "regulator-fixed";
		regulator-name = "cam0_dvdd";
		regulator-always-on;
		regulator-boot-on;
		regulator-min-microvolt = <1200000>;
		regulator-max-microvolt = <1200000>;
		vin-supply = <&vdd_cam0_5v>;
	};

	ext_cam1_37m_clk: external-camera-37m-clock {
		compatible = "fixed-clock";
		clock-frequency = <37125000>;
		clock-output-names = "ext_cam1_37m_clk";
		#clock-cells = <0>;
	};

	ext_cam1_25m_clk: external-camera-25m-clock {
		compatible = "fixed-clock";
		clock-frequency = <25000000>;
		clock-output-names = "ext_cam1_25m_clk";
		#clock-cells = <0>;
	};

	ext_cam1_24m_clk: external-camera-24m-clock {
		compatible = "fixed-clock";
		#clock-cells = <0>;
		clock-frequency = <24000000>;
		clock-output-names = "ext_cam1_24m_clk";
	};

	ext_cam1_27m_clk: external-camera-27m-clock {
		compatible = "fixed-clock";
		#clock-cells = <0>;
		clock-frequency = <27000000>;
		clock-output-names = "ext_cam1_27m_clk";
	};

	vdd_cam1_5v: vdd-cam1-5v-regulator {
		compatible = "regulator-fixed";
		regulator-name = "vdd_cam1_5v";
		regulator-always-on;
		regulator-boot-on;
		regulator-min-microvolt = <3300000>;
		regulator-max-microvolt = <3300000>;
	};

	cam1_dovdd: cam1-dovdd {
		compatible = "regulator-fixed";
		regulator-name = "cam1_dovdd";
		regulator-always-on;
		regulator-boot-on;
		regulator-min-microvolt = <1800000>;
		regulator-max-microvolt = <1800000>;
		vin-supply = <&vdd_cam1_5v>;
	};

	cam1_avdd: cam1-avdd {
		compatible = "regulator-fixed";
		regulator-name = "cam1_avdd";
		regulator-always-on;
		regulator-boot-on;
		regulator-min-microvolt = <2800000>;
		regulator-max-microvolt = <2800000>;
		vin-supply = <&vdd_cam1_5v>;
	};

	cam1_dvdd: cam1-dvdd {
		compatible = "regulator-fixed";
		regulator-name = "cam1_dvdd";
		regulator-always-on;
		regulator-boot-on;
		regulator-min-microvolt = <1200000>;
		regulator-max-microvolt = <1200000>;
		vin-supply = <&vdd_cam1_5v>;
	};

	es8388_sound: es8388-sound {
		status = "okay";
		compatible = "rockchip,multicodecs-card";
		rockchip,card-name = "rockchip-es8388";
		spk-con-gpio = <&gpio3 RK_PD5 GPIO_ACTIVE_HIGH>;
		io-channels = <&saradc 4>;
		io-channel-names = "adc-detect";
		keyup-threshold-microvolt = <1800000>;
		poll-interval = <100>;
		rockchip,format = "i2s";
		rockchip,mclk-fs = <256>;
		rockchip,cpu = <&i2s0_8ch>;
		rockchip,codec = <&es8388>;
		rockchip,audio-routing =
			"Speaker", "LOUT1",
			"Speaker", "ROUT1",
			"Headphone", "LOUT2",
			"Headphone", "ROUT2",
			"Headphone", "Headphone Power",
			"Headphone", "Headphone Power",
			"Speaker", "Speaker Power",
			"Speaker", "Speaker Power",
			"LINPUT2", "Main Mic",
			"RINPUT1", "Main Mic";
		play-pause-key {
			label = "playpause";
			linux,code = <KEY_PLAYPAUSE>;
			press-threshold-microvolt = <2000>;
		};

		previous-song-key {
			label = "previoussong";
			linux,code = <KEY_PREVIOUSSONG>;
			press-threshold-microvolt = <145000>;
		};

		next-song-key {
			label = "nextsong";
			linux,code = <KEY_NEXTSONG>;
			press-threshold-microvolt = <290000>;
		};
	};

	fan: pwm-fan {
		compatible = "pwm-fan";
		#cooling-cells = <2>;
		pwms = <&pwm11 0 5000 0>;
		cooling-levels = <0 100 150 200 255>;
		rockchip,temp-trips = <
			35000	1
			40000	2
			45000	3
			50000	4
		>;
	};

	backlight: backlight {
		status = "okay";
		compatible = "pwm-backlight";
		pwms = <&pwm0 0 25000 0>;
		brightness-levels = <
		0  20  20  21  21  22  22  23
		23  24  24  25  25  26  26  27
		27  28  28  29  29  30  30  31
		31  32  32  33  33  34  34  35
		35  36  36  37  37  38  38  39
		40  41  42  43  44  45  46  47
		48  49  50  51  52  53  54  55
		56  57  58  59  60  61  62  63
		64  65  66  67  68  69  70  71
		72  73  74  75  76  77  78  79
		80  81  82  83  84  85  86  87
		88  89  90  91  92  93  94  95
		96  97  98  99 100 101 102 103
		104 105 106 107 108 109 110 111
		112 113 114 115 116 117 118 119
		120 121 122 123 124 125 126 127
		128 129 130 131 132 133 134 135
		136 137 138 139 140 141 142 143
		144 145 146 147 148 149 150 151
		152 153 154 155 156 157 158 159
		160 161 162 163 164 165 166 167
		168 169 170 171 172 173 174 175
		176 177 178 179 180 181 182 183
		184 185 186 187 188 189 190 191
		192 193 194 195 196 197 198 199
		200 201 202 203 204 205 206 207
		208 209 210 211 212 213 214 215
		216 217 218 219 220 221 222 223
		224 225 226 227 228 229 230 231
		232 233 234 235 236 237 238 239
		240 241 242 243 244 245 246 247
		248 249 250 251 252 253 254 255
		>;
		default-brightness-level = <200>;
	};

	test-power {
		status = "okay";
	};
};

&dmc_opp_table {
	/delete-node/ opp-2750000000;
};

&rockchip_suspend {
	status = "okay";
	rockchip,sleep-debug-en = <1>;
	rockchip,sleep-mode-config = <
		(0
		| RKPM_SLP_ARMOFF_DDRPD
		| RKPM_SLP_PMU_PMUALIVE_32K
		| RKPM_SLP_PMU_DIS_OSC
		| RKPM_SLP_32K_EXT
		)
	>;
	rockchip,wakeup-config = <
		(0
		| RKPM_GPIO_WKUP_EN
		| RKPM_CPU0_WKUP_EN
		)
	>;
};

&pwm11 {
	pinctrl-0 = <&pwm11m2_pins>;
	status = "okay";
};

&av1d {
	status = "okay";
};

&av1d_mmu {
	status = "okay";
};

&cpu_l0 {
	cpu-supply = <&vdd_cpu_lit_s0>;
	mem-supply = <&vdd_cpu_lit_mem_s0>;
};

&cpu_b0 {
	cpu-supply = <&vdd_cpu_big0_s0>;
	mem-supply = <&vdd_cpu_big0_mem_s0>;
};

&cpu_b2 {
	cpu-supply = <&vdd_cpu_big1_s0>;
	mem-supply = <&vdd_cpu_big1_mem_s0>;
};

&gpu {
	mali-supply = <&vdd_gpu_s0>;
	mem-supply = <&vdd_gpu_mem_s0>;
	upthreshold = <60>;
	downdifferential = <30>;
	status = "okay";
};

&dfi {
	status = "okay";
};

&dmc {
	status = "okay";
};

&i2c0 {
	pinctrl-names = "default";
	pinctrl-0 = <&i2c0m2_xfer>;
	status = "okay";
	
	gt911_dsi0: gt911@5d {
		status = "okay";
		compatible = "goodix,gt911";
		reg = <0x5d>;
		interrupt-parent = <&gpio3>;
		interrupts = <RK_PB2 IRQ_TYPE_LEVEL_LOW>;
		reset-gpios = <&gpio6 12 GPIO_ACTIVE_LOW>;
		irq-gpios = <&gpio3 RK_PB2 GPIO_ACTIVE_HIGH>;
		touchscreen-inverted-x = <1>;
		touchscreen-inverted-y = <1>;
	};

	hym8563: hym8563@51 {
		compatible = "haoyu,hym8563";
		reg = <0x51>;
		#clock-cells = <0>;
		clock-frequency = <32768>;
		clock-output-names = "hym8563";
		pinctrl-names = "default";
		pinctrl-0 = <&hym8563_int>;
		interrupt-parent = <&gpio0>;
		interrupts = <RK_PB0 IRQ_TYPE_LEVEL_LOW>;
		wakeup-source;
		status = "disabled";
	};

	vdd_cpu_big0_s0: vdd_cpu_big0_mem_s0: rk8602@42 {
		compatible = "rockchip,rk8602";
		reg = <0x42>;
		vin-supply = <&vcc4v0_sys>;
		regulator-compatible = "rk860x-reg";
		regulator-name = "vdd_cpu_big0_s0";
		regulator-min-microvolt = <550000>;
		regulator-max-microvolt = <1050000>;
		regulator-ramp-delay = <2300>;
		rockchip,suspend-voltage-selector = <1>;
		regulator-boot-on;
		regulator-always-on;
		regulator-state-mem {
			regulator-off-in-suspend;
		};
	};

	vdd_cpu_big1_s0: vdd_cpu_big1_mem_s0: rk8603@43 {
		compatible = "rockchip,rk8603";
		reg = <0x43>;
		vin-supply = <&vcc4v0_sys>;
		regulator-compatible = "rk860x-reg";
		regulator-name = "vdd_cpu_big1_s0";
		regulator-min-microvolt = <550000>;
		regulator-max-microvolt = <1050000>;
		regulator-ramp-delay = <2300>;
		rockchip,suspend-voltage-selector = <1>;
		regulator-boot-on;
		regulator-always-on;
		regulator-state-mem {
			regulator-off-in-suspend;
		};
	};

	gpio6: gpio-expander@21 {
		compatible = "nxp,pca9535";
		status = "okay";
		reg = <0x21>;
		gpio-controller;
		#gpio-cells = <2>;
	};
};

&i2c1 {
	pinctrl-names = "default";
	pinctrl-0 = <&i2c1m2_xfer>;
	status = "okay";

	vdd_npu_s0: vdd_npu_mem_s0: rk8602@42 {
		compatible = "rockchip,rk8602";
		reg = <0x42>;
		vin-supply = <&vcc4v0_sys>;
		regulator-compatible = "rk860x-reg";
		regulator-name = "vdd_npu_s0";
		regulator-min-microvolt = <550000>;
		regulator-max-microvolt = <950000>;
		regulator-ramp-delay = <2300>;
		rockchip,suspend-voltage-selector = <1>;
		regulator-boot-on;
		regulator-always-on;
		regulator-state-mem {
			regulator-off-in-suspend;
		};
	};

	imx415_1: imx415-1@1a {
		compatible = "sony,imx415";
		status = "okay";
		reg = <0x1a>;
		clocks = <&ext_cam1_37m_clk>;
		clock-names = "xvclk";
		avdd-supply = <&cam1_avdd>;
		dovdd-supply = <&cam1_dovdd>;
		dvdd-supply = <&cam1_dvdd>;
		reset-gpios = <&gpio6 3 GPIO_ACTIVE_LOW>;

		rockchip,camera-module-index = <1>;
		rockchip,camera-module-facing = "back";
		rockchip,camera-module-name = "CMK-OT2022-PX1";
		rockchip,camera-module-lens-name = "IR0147-50IRC-8M-F20";
		port {
			imx415_out1: endpoint {
				remote-endpoint = <&dcphy1_in_imx415>;
				data-lanes = <1 2 3 4>;
			};
		};
	};
};

&i2c2 {
	pinctrl-names = "default";
	pinctrl-0 = <&i2c2m4_xfer>;
	status = "okay";
	
	imx415_0: imx415-0@1a {
		compatible = "sony,imx415";
		status = "okay";
		reg = <0x1a>;
		clocks = <&ext_cam0_37m_clk>;
		clock-names = "xvclk";
		avdd-supply = <&cam0_avdd>;
		dovdd-supply = <&cam0_dovdd>;
		dvdd-supply = <&cam0_dvdd>;
		reset-gpios = <&gpio6 1 GPIO_ACTIVE_LOW>;

		rockchip,camera-module-index = <0>;
		rockchip,camera-module-facing = "back";
		rockchip,camera-module-name = "CMK-OT2022-PX1";
		rockchip,camera-module-lens-name = "IR0147-50IRC-8M-F20";
		port {
			imx415_out0: endpoint {
				remote-endpoint = <&dcphy0_in_imx415>;
				data-lanes = <1 2 3 4>;
			};
		};
	};
};

&spi2 {
	status = "okay";
	assigned-clocks = <&cru CLK_SPI2>;
	assigned-clock-rates = <200000000>;
	pinctrl-names = "default";
	pinctrl-0 = <&spi2m2_cs0 &spi2m2_pins>;
	num-cs = <1>;

	rk806single@0 {
		compatible = "rockchip,rk806";
		spi-max-frequency = <1000000>;
		reg = <0x0>;

		interrupt-parent = <&gpio0>;
		interrupts = <RK_PA7 IRQ_TYPE_LEVEL_LOW>;

		pinctrl-names = "default", "pmic-power-off";
		pinctrl-0 = <&pmic_pins>, <&rk806_dvs1_null>, <&rk806_dvs2_null>, <&rk806_dvs3_null>;
		pinctrl-1 = <&rk806_dvs1_pwrdn>;

		/* 2800mv-3500mv */
		low_voltage_threshold = <3000>;
		/* 2700mv-3400mv */
		shutdown_voltage_threshold = <2700>;
		/* 140 160 */
		shutdown_temperture_threshold = <160>;
		hotdie_temperture_threshold = <115>;

		/* 0: restart PMU;
		 * 1: reset all the power off reset registers,
		 *	forcing the state to switch to ACTIVE mode;
		 * 2: Reset all the power off reset registers,
		 *	forcing the state to switch to ACTIVE mode,
		 *	and simultaneously pull down the RESETB PIN for 5mS before releasing
		 */
		pmic-reset-func = <1>;

		vcc1-supply = <&vcc4v0_sys>;
		vcc2-supply = <&vcc4v0_sys>;
		vcc3-supply = <&vcc4v0_sys>;
		vcc4-supply = <&vcc4v0_sys>;
		vcc5-supply = <&vcc4v0_sys>;
		vcc6-supply = <&vcc4v0_sys>;
		vcc7-supply = <&vcc4v0_sys>;
		vcc8-supply = <&vcc4v0_sys>;
		vcc9-supply = <&vcc4v0_sys>;
		vcc10-supply = <&vcc4v0_sys>;
		vcc11-supply = <&vcc_2v0_pldo_s3>;
		vcc12-supply = <&vcc4v0_sys>;
		vcc13-supply = <&vcc_1v1_nldo_s3>;
		vcc14-supply = <&vcc_1v1_nldo_s3>;
		vcca-supply = <&vcc4v0_sys>;

		pwrkey {
			status = "okay";
		};

		pinctrl_rk806: pinctrl_rk806 {
			gpio-controller;
			#gpio-cells = <2>;

			rk806_dvs1_null: rk806_dvs1_null {
				pins = "gpio_pwrctrl2";
				function = "pin_fun0";
			};

			rk806_dvs1_slp: rk806_dvs1_slp {
				pins = "gpio_pwrctrl1";
				function = "pin_fun1";
			};

			rk806_dvs1_pwrdn: rk806_dvs1_pwrdn {
				pins = "gpio_pwrctrl1";
				function = "pin_fun2";
			};

			rk806_dvs1_rst: rk806_dvs1_rst {
				pins = "gpio_pwrctrl1";
				function = "pin_fun3";
			};

			rk806_dvs2_null: rk806_dvs2_null {
				pins = "gpio_pwrctrl2";
				function = "pin_fun0";
			};

			rk806_dvs2_slp: rk806_dvs2_slp {
				pins = "gpio_pwrctrl2";
				function = "pin_fun1";
			};

			rk806_dvs2_pwrdn: rk806_dvs2_pwrdn {
				pins = "gpio_pwrctrl2";
				function = "pin_fun2";
			};

			rk806_dvs2_rst: rk806_dvs2_rst {
				pins = "gpio_pwrctrl2";
				function = "pin_fun3";
			};

			rk806_dvs2_dvs: rk806_dvs2_dvs {
				pins = "gpio_pwrctrl2";
				function = "pin_fun4";
			};

			rk806_dvs2_gpio: rk806_dvs2_gpio {
				pins = "gpio_pwrctrl2";
				function = "pin_fun5";
			};

			rk806_dvs3_null: rk806_dvs3_null {
				pins = "gpio_pwrctrl3";
				function = "pin_fun0";
			};

			rk806_dvs3_slp: rk806_dvs3_slp {
				pins = "gpio_pwrctrl3";
				function = "pin_fun1";
			};

			rk806_dvs3_pwrdn: rk806_dvs3_pwrdn {
				pins = "gpio_pwrctrl3";
				function = "pin_fun2";
			};

			rk806_dvs3_rst: rk806_dvs3_rst {
				pins = "gpio_pwrctrl3";
				function = "pin_fun3";
			};

			rk806_dvs3_dvs: rk806_dvs3_dvs {
				pins = "gpio_pwrctrl3";
				function = "pin_fun4";
			};

			rk806_dvs3_gpio: rk806_dvs3_gpio {
				pins = "gpio_pwrctrl3";
				function = "pin_fun5";
			};
		};

		regulators {
			vdd_gpu_s0: vdd_gpu_mem_s0: DCDC_REG1 {
				regulator-always-on;
				regulator-boot-on;
				regulator-min-microvolt = <550000>;
				regulator-max-microvolt = <950000>;
				regulator-ramp-delay = <12500>;
				regulator-name = "vdd_gpu_s0";
				regulator-state-mem {
					regulator-off-in-suspend;
				};
			};

			vdd_cpu_lit_s0: vdd_cpu_lit_mem_s0: DCDC_REG2 {
				regulator-always-on;
				regulator-boot-on;
				regulator-min-microvolt = <550000>;
				regulator-max-microvolt = <950000>;
				regulator-ramp-delay = <12500>;
				regulator-name = "vdd_cpu_lit_s0";
				regulator-state-mem {
					regulator-off-in-suspend;
				};
			};

			vdd_log_s0: DCDC_REG3 {
				regulator-always-on;
				regulator-boot-on;
				regulator-min-microvolt = <750000>;
				regulator-max-microvolt = <750000>;
				regulator-ramp-delay = <12500>;
				regulator-name = "vdd_log_s0";
				regulator-state-mem {
					regulator-on-in-suspend;
				};
			};

			vdd_vdenc_s0: vdd_vdenc_mem_s0: DCDC_REG4 {
				regulator-always-on;
				regulator-boot-on;
				regulator-min-microvolt = <550000>;
				regulator-max-microvolt = <950000>;
				regulator-init-microvolt = <750000>;
				regulator-ramp-delay = <12500>;
				regulator-name = "vdd_vdenc_s0";
				regulator-state-mem {
					regulator-off-in-suspend;
				};
			};

			vdd_ddr_s0: DCDC_REG5 {
				regulator-always-on;
				regulator-boot-on;
				regulator-min-microvolt = <850000>;
				regulator-max-microvolt = <850000>;
				regulator-ramp-delay = <12500>;
				regulator-name = "vdd_ddr_s0";
				regulator-state-mem {
					regulator-off-in-suspend;
					regulator-suspend-microvolt = <850000>;
				};
			};

			vdd2_ddr_s3: DCDC_REG6 {
				regulator-always-on;
				regulator-boot-on;
				regulator-name = "vdd2_ddr_s3";
				regulator-state-mem {
					regulator-on-in-suspend;
				};
			};

			vcc_2v0_pldo_s3: DCDC_REG7 {
				regulator-always-on;
				regulator-boot-on;
				regulator-min-microvolt = <2000000>;
				regulator-max-microvolt = <2000000>;
				regulator-name = "vdd_2v0_pldo_s3";
				regulator-state-mem {
					regulator-on-in-suspend;
					regulator-suspend-microvolt = <2000000>;
				};
			};

			vcc_3v3_s3: DCDC_REG8 {
				regulator-always-on;
				regulator-boot-on;
				regulator-min-microvolt = <3300000>;
				regulator-max-microvolt = <3300000>;
				regulator-name = "vcc_3v3_s3";
				regulator-state-mem {
					regulator-on-in-suspend;
				};
			};

			vddq_ddr_s0: DCDC_REG9 {
				regulator-always-on;
				regulator-boot-on;
				regulator-name = "vddq_ddr_s0";
				regulator-state-mem {
					regulator-off-in-suspend;
				};
			};

			vcc_1v8_s3: DCDC_REG10 {
				regulator-always-on;
				regulator-boot-on;
				regulator-min-microvolt = <1800000>;
				regulator-max-microvolt = <1800000>;
				regulator-name = "vcc_1v8_s3";
				regulator-state-mem {
					regulator-on-in-suspend;
					regulator-suspend-microvolt = <1800000>;
				};
			};

			avcc_1v8_s0: PLDO_REG1 {
				regulator-always-on;
				regulator-boot-on;
				regulator-min-microvolt = <1800000>;
				regulator-max-microvolt = <1800000>;
				regulator-name = "vcc_1v8_s0";
				regulator-state-mem {
					regulator-on-in-suspend;
				};
			};

			vcc_1v8_s0: PLDO_REG2 {
				regulator-always-on;
				regulator-boot-on;
				regulator-min-microvolt = <1800000>;
				regulator-max-microvolt = <1800000>;
				regulator-name = "vcc_1v8_s0";
				regulator-state-mem {
					regulator-off-in-suspend;
					regulator-suspend-microvolt = <1800000>;
				};
			};

			avdd_1v2_s0: PLDO_REG3 {
				regulator-always-on;
				regulator-boot-on;
				regulator-min-microvolt = <1200000>;
				regulator-max-microvolt = <1200000>;
				regulator-name = "avdd_1v2_s0";
				regulator-state-mem {
					regulator-off-in-suspend;
				};
			};

			avcc_3v3_s0: PLDO_REG4 {
				regulator-always-on;
				regulator-boot-on;
				regulator-min-microvolt = <3300000>;
				regulator-max-microvolt = <3300000>;
				regulator-name = "avcc_3v3_s0";
				regulator-state-mem {
					regulator-off-in-suspend;
				};
			};

			vccio_sd_s0: PLDO_REG5 {
				regulator-always-on;
				regulator-boot-on;
				regulator-min-microvolt = <1800000>;
				regulator-max-microvolt = <3300000>;
				regulator-name = "vccio_sd_s0";
				regulator-state-mem {
					regulator-off-in-suspend;
				};
			};

			pldo6_s3: PLDO_REG6 {
				regulator-always-on;
				regulator-boot-on;
				regulator-min-microvolt = <1800000>;
				regulator-max-microvolt = <1800000>;
				regulator-name = "pldo6_s3";
				regulator-state-mem {
					regulator-on-in-suspend;
					regulator-suspend-microvolt = <1800000>;
				};
			};

			vdd_0v75_s3: NLDO_REG1 {
				regulator-always-on;
				regulator-boot-on;
				regulator-min-microvolt = <750000>;
				regulator-max-microvolt = <750000>;
				regulator-name = "vdd_0v75_s3";
				regulator-state-mem {
					regulator-on-in-suspend;
					regulator-suspend-microvolt = <750000>;
				};
			};

			avdd_ddr_pll_s0: NLDO_REG2 {
				regulator-always-on;
				regulator-boot-on;
				regulator-min-microvolt = <850000>;
				regulator-max-microvolt = <850000>;
				regulator-name = "avdd_ddr_pll_s0";
				regulator-state-mem {
					regulator-off-in-suspend;
					regulator-suspend-microvolt = <850000>;
				};
			};

			avdd_0v75_s0: NLDO_REG3 {
				regulator-always-on;
				regulator-boot-on;
				regulator-min-microvolt = <750000>;
				regulator-max-microvolt = <750000>;
				regulator-name = "avdd_0v75_s0";
				regulator-state-mem {
					regulator-off-in-suspend;
				};
			};

			avdd_0v85_s0: NLDO_REG4 {
				regulator-always-on;
				regulator-boot-on;
				regulator-min-microvolt = <850000>;
				regulator-max-microvolt = <850000>;
				regulator-name = "avdd_0v85_s0";
				regulator-state-mem {
					regulator-off-in-suspend;
				};
			};

			vdd_0v75_s0: NLDO_REG5 {
				regulator-always-on;
				regulator-boot-on;
				regulator-min-microvolt = <750000>;
				regulator-max-microvolt = <750000>;
				regulator-name = "vdd_0v75_s0";
				regulator-state-mem {
					regulator-off-in-suspend;
				};
			};
		};
	};
};

&i2c7 {
	pinctrl-names = "default";
	pinctrl-0 = <&i2c7m0_xfer>;
	status = "okay";

	es8388: es8388@11 {
		status = "okay";
		#sound-dai-cells = <0>;
		compatible = "everest,es8388", "everest,es8323";
		reg = <0x11>;
		clocks = <&mclkout_i2s0>;
		clock-names = "mclk";
		assigned-clocks = <&mclkout_i2s0>;
		assigned-clock-rates = <12288000>;
		pinctrl-names = "default";
		pinctrl-0 = <&i2s0_mclk>;
	};
};

&i2s0_8ch {
	status = "okay";
	rockchip,clk-trcm = <1>;
	pinctrl-0 = <&i2s0_lrck
			 &i2s0_sclk
			 &i2s0_sdi0
			 &i2s0_sdo0>;
};

&saradc {
	status = "okay";
	vref-supply = <&avcc_1v8_s0>;
};

&tsadc {
	status = "okay";
};

&sdhci {
	bus-width = <8>;
	no-sdio;
	no-sd;
	non-removable;
	max-frequency = <200000000>;
	mmc-hs400-1_8v;
	mmc-hs400-enhanced-strobe;
	full-pwr-cycle-in-suspend;
	status = "okay";
};

&sdmmc {
	max-frequency = <200000000>;
	no-sdio;
	no-mmc;
	bus-width = <4>;
	cap-mmc-highspeed;
	cap-sd-highspeed;
	disable-wp;
	sd-uhs-sdr104;
	vmmc-supply = <&vcc3v3_sd_s3>;
	vqmmc-supply = <&vccio_sd_s0>;
	pinctrl-names = "default";
	pinctrl-0 = <&sdmmc_bus4 &sdmmc_clk &sdmmc_cmd &sdmmc_det>;
	status = "okay";
};

&iep {
	status = "okay";
};

&iep_mmu {
	status = "okay";
};

&jpegd {
	status = "okay";
};

&jpegd_mmu {
	status = "okay";
};

&jpege_ccu {
	status = "okay";
};

&jpege0 {
	status = "okay";
};

&jpege0_mmu {
	status = "okay";
};

&jpege1 {
	status = "okay";
};

&jpege1_mmu {
	status = "okay";
};

&jpege2 {
	status = "okay";
};

&jpege2_mmu {
	status = "okay";
};

&jpege3 {
	status = "okay";
};

&jpege3_mmu {
	status = "okay";
};

&mpp_srv {
	status = "okay";
};

&pwm4 {
	pinctrl-0 = <&pwm4m0_pins>;
	status = "okay";
};

&pwm2 {
	pinctrl-0 = <&pwm2m0_pins>;
	status = "okay";
};

&pwm6 {
	pinctrl-0 = <&pwm6m0_pins>;
	status = "okay";
};

&rga3_core0 {
	status = "okay";
};

&rga3_0_mmu {
	status = "okay";
};

&rga3_core1 {
	status = "okay";
};

&rga3_1_mmu {
	status = "okay";
};

&rga2 {
	status = "okay";
};

&rknpu {
	rknpu-supply = <&vdd_npu_s0>;
	mem-supply = <&vdd_npu_mem_s0>;
	status = "okay";
};

&rknpu_mmu {
	status = "okay";
};

&rkvdec_ccu {
	status = "okay";
};

&rkvdec0 {
	status = "okay";
};

&rkvdec0_mmu {
	status = "okay";
};

&rkvdec1 {
	status = "okay";
};

&rkvdec1_mmu {
	status = "okay";
};

&rkvenc_ccu {
	status = "okay";
};

&rkvenc0 {
	status = "okay";
};

&rkvenc0_mmu {
	status = "okay";
};

&rkvenc1 {
	status = "okay";
};

&rkvenc1_mmu {
	status = "okay";
};

/* this is a watchdog */
&wdt {
	status = "okay";
};

&gmac0 {
	/* Use rgmii-rxid mode to disable rx delay inside Soc */
	phy-mode = "rgmii-rxid";
	clock_in_out = "output";

	snps,reset-gpio = <&gpio3 RK_PC0 GPIO_ACTIVE_LOW>;
	snps,reset-active-low;
	/* Reset time is 20ms, 100ms for rtl8211f */
	snps,reset-delays-us = <0 20000 100000>;

	pinctrl-names = "default";
	pinctrl-0 = <&gmac0_miim
			 &gmac0_tx_bus2
			 &gmac0_rx_bus2
			 &gmac0_rgmii_clk
			 &gmac0_rgmii_bus>;

	tx_delay = <0x26>;
	/* rx_delay = <0x4f>; */

	phy-handle = <&rgmii_phy0>;
	status = "disabled";
};

&gmac1 {
	/* Use rgmii-rxid mode to disable rx delay inside Soc */
	phy-mode = "rgmii-rxid";
	clock_in_out = "output";

	snps,reset-gpio = <&gpio3 RK_PC1 GPIO_ACTIVE_LOW>;
	snps,reset-active-low;
	/* Reset time is 20ms, 100ms for rtl8211f */
	snps,reset-delays-us = <0 20000 100000>;

	pinctrl-names = "default";
	pinctrl-0 = <&gmac1_miim
			 &gmac1_tx_bus2
			 &gmac1_rx_bus2
			 &gmac1_rgmii_clk
			 &gmac1_rgmii_bus>;

	tx_delay = <0x18>;
	/* rx_delay = <0x4f>; */

	phy-handle = <&rgmii_phy1>;
	status = "disabled";
};

&mdio0 {
	rgmii_phy0: phy@0 {
		compatible = "ethernet-phy-ieee802.3-c22";
		reg = <0x0>;
	};
};

&mdio1 {
	rgmii_phy1: phy@1 {
		compatible = "ethernet-phy-ieee802.3-c22";
		reg = <0x01>;
	};
};

/* PCIe30 PHY Port0 & Port1 */
&pcie30phy {
	rockchip,pcie30-phymode = <PHY_MODE_PCIE_NANBNB>;
	status = "okay";
};

// PCIe30 Port0: M.2 M-Key
&pcie3x4 {
	num-lanes = <2>;
	vpcie3v3-supply = <&vcc3v3_m2_pcie>;
	reset-gpios = <&gpio4 RK_PB6 GPIO_ACTIVE_HIGH>;
	status = "okay";
};

// PCIe30 Port1: PCIe-64P
// &pcie3x2 {
// 	vpcie3v3-supply = <&vcc3v3_pciex4>;
// 	reset-gpios = <&gpio4 RK_PB1 GPIO_ACTIVE_HIGH>;
// 	status = "okay";
// };

/* SATA30_HOST0/PCIe20x1_2 Combo PHY */
&combphy0_ps {
	status = "okay";
};

// SATA
// &sata0{
// 	status = "okay";
// };

/* SATA30_HOST1/PCIe20x1_0 Combo PHY */
&combphy1_ps {
	status = "okay";
};

// M.2 E-Key
// &pcie2x1l0 {
// 	reset-gpios = <&gpio0 RK_PC5 GPIO_ACTIVE_HIGH>;
// 	disable-gpios = <&gpio0 RK_PC6 GPIO_ACTIVE_HIGH>;
// 	vpcie3v3-supply = <&vcc3v3_m2_pcie>;
// 	status = "okay";
// };

/* USB30_HOST2/SATA30_HOST2/PCIe20x1_1 Combo PHY */
&combphy2_psu {
	status = "okay";
};

// Mini-PCIe
&pcie2x1l1 {
	reset-gpios = <&gpio4 RK_PA2 GPIO_ACTIVE_HIGH>;
	disable-gpios = <&gpio3 RK_PA6 GPIO_ACTIVE_HIGH>;
	vpcie3v3-supply = <&vcc3v3_mini_pcie>;
	status = "okay";
};

/* USB3.0_OTG/DP1.4 Combo PHY0 */
&usbdp_phy0 {
	orientation-switch;
	svid = <0xff01>;
	sbu1-dc-gpios = <&gpio1 RK_PB0 GPIO_ACTIVE_HIGH>;
	sbu2-dc-gpios = <&gpio1 RK_PB1 GPIO_ACTIVE_HIGH>;
	status = "okay";

	// port {
	// 	#address-cells = <1>;
	// 	#size-cells = <0>;
	// 	usbdp_phy0_orientation_switch: endpoint@0 {
	// 		reg = <0>;
	// 		remote-endpoint = <&usbc0_orien_sw>;
	// 	};

	// 	usbdp_phy0_dp_altmode_mux: endpoint@1 {
	// 		reg = <1>;
	// 		remote-endpoint = <&dp_altmode_mux>;
	// 	};
	// };
};

&usbdp_phy0_u3 {
	status = "okay";
};

&usbdp_phy0_dp {
	status = "okay";
};

/* USB3.0 OTG0 Controller  */
&usbdrd3_0 {
	status = "okay";
};

&usbdrd_dwc3_0 {
	dr_mode = "otg";
	extcon = <&u2phy0>;
	maximum-speed = "high-speed";
	status = "okay";
};

/* USB2.0 PHY0 */
&u2phy0 {
	status = "okay";
};

&u2phy0_otg {
	status = "okay";
};

/* USB3.0_OTG/DP1.4 Combo PHY1 */
&usbdp_phy1 {
	rockchip,dp-lane-mux = <2 3>;
	status = "okay";
};

&usbdp_phy1_u3 {
	status = "okay";
};

&usbdrd3_1 {
	status = "okay";
};

&usbdrd_dwc3_1 {
	dr_mode = "host";
	status = "okay";
};

/* USB2.0 PHY1 */
&u2phy1 {
	status = "okay";
};

&u2phy1_otg {
	phy-supply = <&vcc5v0_usb30_otg>;
	status = "okay";
};

/* USB2.0 HOST0 PHY2 */
&u2phy2 {
	status = "okay";
};

&u2phy2_host {
	phy-supply = <&vcc5v0_usb20_host>;
	status = "okay";
};

/* USB2.0 HOST0 Controller */
&usb_host0_ehci {
	status = "okay";
};

&usb_host0_ohci {
	status = "okay";
};

/* USB2.0 HOST1 PHY3 */
&u2phy3 {
	status = "okay";
};

&u2phy3_host {
	phy-supply = <&vcc5v0_usb20_hub>;
	status = "okay";
};

/* USB2.0 HOST1 Controller */
&usb_host1_ehci {
	status = "okay";
};

&usb_host1_ohci {
	status = "okay";
};

&vdpu {
	status = "disabled";
};

&vdpu_mmu {
	status = "disabled";
};

&vepu {
	status = "disabled";
};

&vop {
	status = "okay";
	// disable-win-move;
};

&vop_mmu {
	status = "okay";
};

/* vp0 & vp1 splice for 8K output */
&vp0 {
	rockchip,plane-mask = <(1 << ROCKCHIP_VOP2_CLUSTER0 | 1 << ROCKCHIP_VOP2_ESMART0)>;
	rockchip,primary-plane = <ROCKCHIP_VOP2_ESMART0>;
};

&vp1 {
	rockchip,plane-mask = <(1 << ROCKCHIP_VOP2_CLUSTER1 | 1 << ROCKCHIP_VOP2_ESMART1)>;
	rockchip,primary-plane = <ROCKCHIP_VOP2_ESMART1>;
};

&vp2 {
	rockchip,plane-mask = <(1 << ROCKCHIP_VOP2_CLUSTER2 | 1 << ROCKCHIP_VOP2_ESMART2)>;
	rockchip,primary-plane = <ROCKCHIP_VOP2_ESMART2>;
};

&vp3 {
	rockchip,plane-mask = <(1 << ROCKCHIP_VOP2_CLUSTER3 | 1 << ROCKCHIP_VOP2_ESMART3)>;
	rockchip,primary-plane = <ROCKCHIP_VOP2_ESMART3>;
};

&mipi_dcphy0 {
	status = "okay";
};

&csi2_dcphy0 {
	status = "okay";

	ports {
		#address-cells = <1>;
		#size-cells = <0>;
		port@0 {
			reg = <0>;
			#address-cells = <1>;
			#size-cells = <0>;

			dcphy0_in_imx415: endpoint@5 {
				reg = <5>;
				remote-endpoint = <&imx415_out0>;
				data-lanes = <1 2 3 4>;
			};
		};
		port@1 {
			reg = <1>;
			#address-cells = <1>;
			#size-cells = <0>;
			csidcphy0_out: endpoint@0 {
				reg = <0>;
				remote-endpoint = <&mipi0_csi2_input>;
			};
		};
	};
};

&mipi0_csi2 {
	status = "okay";
	ports {
		#address-cells = <1>;
		#size-cells = <0>;
		port@0 {
			reg = <0>;
			#address-cells = <1>;
			#size-cells = <0>;
			mipi0_csi2_input: endpoint@1 {
				reg = <1>;
				remote-endpoint = <&csidcphy0_out>;
			};
		};
		port@1 {
			reg = <1>;
			#address-cells = <1>;
			#size-cells = <0>;
			mipi0_csi2_output: endpoint@0 {
				reg = <0>;
				remote-endpoint = <&cif_mipi0_in0>;
			};
		};
	};
};

&rkcif {
	status = "okay";
};

&rkcif_mipi_lvds {
	status = "okay";

	port {
		cif_mipi0_in0: endpoint {
			remote-endpoint = <&mipi0_csi2_output>;
		};
	};
};

&rkcif_mipi_lvds_sditf {
	status = "okay";

	port {
		mipi_lvds_sditf: endpoint {
			remote-endpoint = <&isp0_vir0>;
		};
	};
};

&rkcif_mmu {
	status = "okay";
};

&rkisp0 {
	status = "okay";
};

&isp0_mmu {
	status = "okay";
};

&rkisp0_vir0 {
	status = "okay";

	port {
		#address-cells = <1>;
		#size-cells = <0>;
		isp0_vir0: endpoint@0 {
			reg = <0>;
			remote-endpoint = <&mipi_lvds_sditf>;
		};
	};
};

&mipi_dcphy1 {
	status = "okay";
};

&csi2_dcphy1 {
	status = "okay";

	ports {
		#address-cells = <1>;
		#size-cells = <0>;
		port@0 {
			reg = <0>;
			#address-cells = <1>;
			#size-cells = <0>;

			dcphy1_in_imx415: endpoint@5 {
				reg = <5>;
				remote-endpoint = <&imx415_out1>;
				data-lanes = <1 2 3 4>;
			};
		};
		port@1 {
			reg = <1>;
			#address-cells = <1>;
			#size-cells = <0>;
			csidcphy1_out: endpoint@0 {
				reg = <0>;
				remote-endpoint = <&mipi1_csi2_input>;
			};
		};
	};
};

&mipi1_csi2 {
	status = "okay";

	ports {
		#address-cells = <1>;
		#size-cells = <0>;
		port@0 {
			reg = <0>;
			#address-cells = <1>;
			#size-cells = <0>;
			mipi1_csi2_input: endpoint@1 {
				reg = <1>;
				remote-endpoint = <&csidcphy1_out>;
			};
		};
		port@1 {
			reg = <1>;
			#address-cells = <1>;
			#size-cells = <0>;
			mipi1_csi2_output: endpoint@0 {
				reg = <0>;
				remote-endpoint = <&cif_mipi1_in0>;
			};
		};
	};
};

&rkcif {
	status = "okay";
};

&rkcif_mipi_lvds1 {
	status = "okay";

	port {
		cif_mipi1_in0: endpoint {
			remote-endpoint = <&mipi1_csi2_output>;
		};
	};
};

&rkcif_mipi_lvds1_sditf {
	status = "okay";

	port {
		mipi_lvds1_sditf: endpoint {
			remote-endpoint = <&isp0_vir1>;
		};
	};
};

&rkisp0 {
	status = "okay";
};

&isp0_mmu {
	status = "okay";
};

&rkisp0_vir1 {
	status = "okay";

	port {
		#address-cells = <1>;
		#size-cells = <0>;
		isp0_vir1: endpoint@0 {
			reg = <0>;
			remote-endpoint = <&mipi_lvds1_sditf>;
		};
	};
};

&uart4 {
	status = "okay";
	pinctrl-0 = <&uart4m2_xfer>;
};

// &uart7 {
// 	status = "okay";
// 	pinctrl-0 = <&uart7m2_xfer>;
// };

&can1 {
	assigned-clocks = <&cru CLK_CAN1>;
	assigned-clock-rates = <150000000>;
	pinctrl-names = "default";
	pinctrl-0 = <&can1m1_pins>;
	status = "disabled";
};

&can2 {
	assigned-clocks = <&cru CLK_CAN2>;
	assigned-clock-rates = <150000000>;
	pinctrl-names = "default";
	pinctrl-0 = <&can2m0_pins>;
	status = "disabled";
};

&pinctrl {
	hym8563 {
		hym8563_int: hym8563-int {
			rockchip,pins = <0 RK_PB0 RK_FUNC_GPIO &pcfg_pull_up>;
		};
	};

	headphone {
		hp_det: hp-det {
			rockchip,pins = <0 RK_PA0 RK_FUNC_GPIO &pcfg_pull_none>;
		};
	};

	wlan {
		host_wake_wlan_pin: host-wake-wlan-pin {
			rockchip,pins = <0 RK_PC7 RK_FUNC_GPIO &pcfg_pull_up>;
		};

		host_wake_bt_pin: host-wake-bt-pin {
			rockchip,pins = <0 RK_PC6 RK_FUNC_GPIO &pcfg_pull_up>;
		};
	};

	usb-typec {
		fusb302_int: fusb302-int {
			rockchip,pins = <0 RK_PD3 RK_FUNC_GPIO &pcfg_pull_up>;
		};

		typec_vbus_en: typec-vbus-en {
			rockchip,pins = <4 RK_PA3 RK_FUNC_GPIO &pcfg_pull_none>;
		};

		vcc5v0_usb30_otg_en: vcc5v0-usb30-otg-en {
			rockchip,pins = <4 RK_PA4 RK_FUNC_GPIO &pcfg_pull_none>;
		};

		vcc5v0_usb20_hub_en: vcc5v0-usb20-hub-en {
			rockchip,pins = <4 RK_PA5 RK_FUNC_GPIO &pcfg_pull_none>;
		};

		vcc5v0_usb20_host_en: vcc5v0-usb20-host-en {
			rockchip,pins = <2 RK_PC3 RK_FUNC_GPIO &pcfg_pull_none>;
		};

		vcc3v3_m2_pcie_en: vcc3v3-m2-pcie-en {
			rockchip,pins = <2 RK_PC5 RK_FUNC_GPIO &pcfg_pull_none>;
		};

		vcc3v3_pcie_en: vcc3v3-pcie-en {
			rockchip,pins = <4 RK_PC6 RK_FUNC_GPIO &pcfg_pull_none>;
		};

		vcc3v3_mini_pcie_en: vcc3v3-mini-pcie-en {
			rockchip,pins = <1 RK_PD5 RK_FUNC_GPIO &pcfg_pull_none>;
		};

		vcc3v3_ekey_pcie_en: vcc3v3-ekey-pcie-en {
			rockchip,pins = <0 RK_PB7 RK_FUNC_GPIO &pcfg_pull_none>;
		};
	};

	mipi {
		mipi_dsi0_power_en: mipi-dsi0-power-en {
			rockchip,pins = <1 RK_PC0 RK_FUNC_GPIO &pcfg_pull_none>;
		};

		mipi_dsi1_power_en: mipi-dsi1-power-en {
			rockchip,pins = <1 RK_PC1 RK_FUNC_GPIO &pcfg_pull_none>;
		};
	};

	sata {
		sata_power_en: sata-power-en {
			rockchip,pins = <1 RK_PD3 RK_FUNC_GPIO &pcfg_pull_none>;
		};
	};

	leds {
		sys_led_pin: sys-led-pin {
			rockchip,pins = <1 RK_PC6 RK_FUNC_GPIO &pcfg_pull_none>;
		};
	};
};

&route_dsi0 {
	status = "okay";
	connect = <&vp2_out_dsi0>;
};

&dsi0_in_vp2 {
	status = "okay";
};

&dsi0 {
	status = "okay";
	#address-cells = <1>;
	#size-cells = <0>;

	dsi0_panel: panel@0 {
		status = "okay";
		compatible = "simple-panel-dsi";
		reg = <0>;
		backlight = <&backlight>;
		power-supply = <&mipi_dsi0_power>;
		reset-gpios = <&gpio6 13 GPIO_ACTIVE_LOW>;

		enable-delay-ms = <35>;
		prepare-delay-ms = <6>;
		reset-delay-ms = <10>;
		init-delay-ms = <50>;
		unprepare-delay-ms = <0>;
		disable-delay-ms = <20>;

		size,width = <74>;
		size,height = <133>;

		dsi,flags = <(MIPI_DSI_MODE_VIDEO | MIPI_DSI_MODE_VIDEO_BURST | MIPI_DSI_MODE_LPM | MIPI_DSI_MODE_EOT_PACKET)>;
		dsi,format = <MIPI_DSI_FMT_RGB888>;
		dsi,lanes  = <4>;

		panel-init-sequence = [
			39 00 04 B9 FF 83 99
			15 00 02 D2 77
			39 00 10 B1 02 04 74 94 01 32 33 11 11 AB 4D 56 73 02 02
			39 00 10 B2 00 80 80 AE 05 07 5A 11 00 00 10 1E 70 03 D4
			15 00 02 36 02
			39 00 2D B4 00 FF 02 C0 02 C0 00 00 08 00 04 06 00 32 04 0A 08 21 03 01 00 0F B8 8B 02 C0 02 C0 00 00 08 00 04 06 00 32 04 0A 08 01 00 0F B8 01
			39 05 22 D3 00 00 00 00 00 00 06 00 00 10 04 00 04 00 00 00 00 00 00 00 00 00 00 01 00 05 05 07 00 00 00 05 40
			39 05 21 D5 18 18 19 19 18 18 21 20 01 00 07 06 05 04 03 02 18 18 18 18 18 18 2F 2F 30 30 31 31 18 18 18 18
			39 05 21 D6 18 18 19 19 40 40 20 21 06 07 00 01 02 03 04 05 40 40 40 40 40 40 2F 2F 30 30 31 31 40 40 40 40
			39 00 11 D8 A2 AA 02 A0 A2 A8 02 A0 B0 00 00 00 B0 00 00 00
			15 00 02 BD 01
			39 00 11 D8 B0 00 00 00 B0 00 00 00 E2 AA 03 F0 E2 AA 03 F0
			15 00 02 BD 02
			39 00 09 D8 E2 AA 03 F0 E2 AA 03 F0
			15 00 02 BD 00
			39 00 03 B6 8D 8D
			39 05 37 E0 00 0E 19 13 2E 39 48 44 4D 57 5F 66 6C 76 7F 85 8A 95 9A A4 9B AB B0 5C 58 64 77 00 0E 19 13 2E 39 48 44 4D 57 5F 66 6C 76 7F 85 8A 95 9A A4 9B AB B0 5C 58 64 77
			05 C8 01 11
			05 C8 01 29
		];

		panel-exit-sequence = [
			05 78 01 28
			05 00 01 10
		];

		disp0_timings0: display-timings {
			native-mode = <&dsi0_timing0>;
			dsi0_timing0: timing0 {
				clock-frequency = <131376000>;
				hactive = <1080>;
				vactive = <1920>;
				hsync-len = <10>;
				hback-porch = <20>;
				hfront-porch = <10>;
				vsync-len = <5>;
				vback-porch = <20>;
				vfront-porch = <10>;
				hsync-active = <0>;
				vsync-active = <0>;
				de-active = <0>;
				pixelclk-active = <0>;
			};
		};

		ports {
			#address-cells = <1>;
			#size-cells = <0>;
			port@0 {
				reg = <0>;
				panel_in_dsi0: endpoint {
					remote-endpoint = <&dsi0_out_panel>;
				};
			};
		};
	};

	ports {
		#address-cells = <1>;
		#size-cells = <0>;

		port@1 {
			reg = <1>;
			dsi0_out_panel: endpoint {
				remote-endpoint = <&panel_in_dsi0>;
			};
		};
	};
};

&pwm0 {
	pinctrl-0 = <&pwm0m2_pins>;
	status = "okay";
};
