// SPDX-License-Identifier: (GPL-2.0+ OR MIT)
/*
 * Copyright (c) 2021 Rockchip Electronics Co., Ltd.
 * Copyright (c) 2023 EmbedFire <embedfire@embedfire.com>
 */

/dts-v1/;

#include "rk3588-lubancat-5-v2.dtsi"
#include "rk3588-android.dtsi"

//野火10.1寸屏幕
#include "rk3588-lubancat-5-dsi0-ebf410177_800x1280.dtsi"
#include "rk3588-lubancat-5-dsi1-ebf410177_800x1280.dtsi"

/ {
	model = "Embedfire LubanCat-5-v2";
	compatible = "embedfire,rk3588-lubancat-5-v2", "rockchip,rk3588";
};
