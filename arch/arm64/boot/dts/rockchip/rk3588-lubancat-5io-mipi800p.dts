// SPDX-License-Identifier: (GPL-2.0+ OR MIT)
/*
 * Copyright (c) 2021 Rockchip Electronics Co., Ltd.
 * Copyright (c) 2023 EmbedFire <embedfire@embedfire.com>
 */

/dts-v1/;

#include "rk3588-lubancat-5io.dtsi"
#include "rk3588-lubancat-5io-dsi0-vp2-800p.dtsi"
#include "rk3588-lubancat-5io-dsi1-vp3-800p.dtsi"

/ {
	model = "Embedfire LubanCat-5";
	compatible = "rockchip,rk3588-lubancat-5", "rockchip,rk3588";
};
